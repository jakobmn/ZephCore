## zephcore/boards/nrf52840/promicro_lr2021/Kconfig.promicro_lr2021
```kconfig
# ProMicro LR2021 board configuration
# Copyright (c) 2025 ZephCore
# SPDX-License-Identifier: Apache-2.0

config BOARD_PROMICRO_LR2021
	select SOC_NRF52840_QIAA
```

## zephcore/boards/nrf52840/promicro_lr2021/board.yml
```yaml
# Copyright (c) 2025 ZephCore
# SPDX-License-Identifier: Apache-2.0
board:
  name: promicro_lr2021
  full_name: ProMicro LR2021 (nRF52840 SuperMini + LR2021)
  vendor: zephcore
  socs:
    - name: nrf52840
```

## zephcore/boards/nrf52840/xiao_nrf52840/Kconfig.xiao_nrf52840
```kconfig
# Copyright (c) 2025 ZephCore
# SPDX-License-Identifier: Apache-2.0

config BOARD_XIAO_NRF52840
	select SOC_NRF52840_QIAA
```

## zephcore/boards/nrf52840/xiao_nrf52840/board.yml
```yaml
# Copyright (c) 2025 ZephCore
# SPDX-License-Identifier: Apache-2.0

board:
  name: xiao_nrf52840
  full_name: Seeed XIAO nRF52840 (Wio-SX1262)
  vendor: seeed
  socs:
  - name: nrf52840
```

## zephcore/west.yml
```yaml
manifest:
  remotes:
    - name: zephyrproject-rtos
      url-base: https://github.com/zephyrproject-rtos

  projects:
    - name: hal_espressif
      remote: zephyrproject-rtos
      revision: b7953b8019361d09e613f7011d2ccc41b984d087
      path: modules/hal/espressif
    - name: zephyr
      remote: zephyrproject-rtos
      revision: 684c9e8f32e4373a21098559f748f06915f950c9
      import: true

  self:
    path: zephcore
```
